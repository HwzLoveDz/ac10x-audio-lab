## firmware/source/main/Kconfig.projbuild
```kconfig
menu "AC10x audio bridge GPIO routing"
    config BRIDGE_MCLK_GPIO
        int "I2S MCLK (to codec)"
        range 1 48
        default 8
    config BRIDGE_BCLK_GPIO
        int "I2S BCLK (to codec)"
        range 1 48
        default 9
    config BRIDGE_LRCK_GPIO
        int "I2S LRCK (to codec)"
        range 1 48
        default 10
    config BRIDGE_DOUT_GPIO
        int "I2S data out (to codec SDIN)"
        range 1 48
        default 11
    config BRIDGE_DIN_GPIO
        int "I2S data in (from codec SDOUT)"
        range 1 48
        default 12
    config BRIDGE_SDA_GPIO
        int "I2C SDA (3.3V logic only)"
        range 1 48
        default 13
    config BRIDGE_SCL_GPIO
        int "I2C SCL (3.3V logic only)"
        range 1 48
        default 14
endmenu
```

## firmware/source/sdkconfig.defaults
```kconfig
CONFIG_ESPTOOLPY_FLASHFREQ_80M=y
CONFIG_ESPTOOLPY_FLASHMODE_DIO=y
CONFIG_PARTITION_TABLE_CUSTOM=y
CONFIG_PARTITION_TABLE_OFFSET=0x8000
CONFIG_ESP_CONSOLE_UART_DEFAULT=y
CONFIG_ESP_CONSOLE_SECONDARY_NONE=y
# CONFIG_USJ_ENABLE_USB_SERIAL_JTAG is not set
CONFIG_FREERTOS_HZ=1000
CONFIG_ESP_MAIN_TASK_STACK_SIZE=8192
# CONFIG_PM_ENABLE is not set
CONFIG_COMPILER_OPTIMIZATION_PERF=y

CONFIG_I2S_ISR_IRAM_SAFE=y
CONFIG_BRIDGE_MCLK_GPIO=8
CONFIG_BRIDGE_BCLK_GPIO=9
CONFIG_BRIDGE_LRCK_GPIO=10
CONFIG_BRIDGE_DOUT_GPIO=11
CONFIG_BRIDGE_DIN_GPIO=12
CONFIG_BRIDGE_SDA_GPIO=13
CONFIG_BRIDGE_SCL_GPIO=14

CONFIG_SPIRAM=y

CONFIG_LIBC_NEWLIB=y

CONFIG_SPIRAM_MODE_OCT=y
CONFIG_SPIRAM_IGNORE_NOTFOUND=y
# CONFIG_SPIRAM_ALLOW_BSS_SEG_EXTERNAL_MEMORY is not set
```

## firmware/source/sdkconfig.defaults.esp32s3
```kconfig
CONFIG_ESPTOOLPY_FLASHSIZE_4MB=y
CONFIG_PARTITION_TABLE_CUSTOM_FILENAME="partitions.csv"
CONFIG_ESP_DEFAULT_CPU_FREQ_MHZ_240=y
```
